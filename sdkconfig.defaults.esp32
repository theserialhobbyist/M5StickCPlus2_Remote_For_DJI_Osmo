## sdkconfig.defaults.m5stickc_plus2
```kconfig
# Configuration for M5StickC Plus2 (ESP32-PICO-V3-02)
#
CONFIG_IDF_TARGET="esp32"

# Bluetooth configuration
CONFIG_BT_ENABLED=y
CONFIG_BT_BLE_50_FEATURES_SUPPORTED=n
CONFIG_BT_BLE_42_FEATURES_SUPPORTED=y

# Flash configuration for M5StickC Plus2 (4MB Flash)
CONFIG_ESPTOOLPY_FLASHSIZE_4MB=y
CONFIG_ESPTOOLPY_FLASHSIZE="4MB"
CONFIG_ESPTOOLPY_FLASHMODE_DIO=y
CONFIG_ESPTOOLPY_FLASHFREQ_80M=y

# CPU frequency
CONFIG_ESP32_DEFAULT_CPU_FREQ_240=y
CONFIG_ESP32_DEFAULT_CPU_FREQ_MHZ=240

# FreeRTOS
CONFIG_FREERTOS_HZ=1000

# SPI Configuration for Display
CONFIG_SPI_MASTER_ISR_IN_IRAM=y

# Power Management
CONFIG_PM_ENABLE=y
```
